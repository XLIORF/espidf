## 07.2_wifi_tcp/components/i2c_bus0/Kconfig.projbuild
```kconfig
menu "I2C Bus0 Master Config"

    config I2C_MASTER_SCL
        int "SCL GPIO Num"
        default 6 if IDF_TARGET_ESP32C3
        default 22 if IDF_TARGET_ESP32 || IDF_TARGET_ESP32S2 || IDF_TARGET_ESP32S3
        help
            GPIO number for I2C Master clock line.

    config I2C_MASTER_SDA
        int "SDA GPIO Num"
        default 5 if IDF_TARGET_ESP32C3
        default 21 if IDF_TARGET_ESP32 || IDF_TARGET_ESP32S2 || IDF_TARGET_ESP32S3
        help
            GPIO number for I2C Master data line.

    config I2C_MASTER_NUM
        int "I2C Port Num"
        default 0 if IDF_TARGET_ESP32C3
        default 0 if IDF_TARGET_ESP32 || IDF_TARGET_ESP32S2 || IDF_TARGET_ESP32S3
        help
            I2C Master Port.

    config I2C_MASTER_FREQ_HZ
        int "I2C_MASTER_FREQ_HZ"
        default 400000 if IDF_TARGET_ESP32C3
        default 400000 if IDF_TARGET_ESP32 || IDF_TARGET_ESP32S2 || IDF_TARGET_ESP32S3
        help
            I2C Master frequenty.

    config I2C_MASTER_TIMEOUT_MS
        int "I2C_MASTER_TIMEOUT_MS"
        default 1000 if IDF_TARGET_ESP32C3
        default 1000 if IDF_TARGET_ESP32 || IDF_TARGET_ESP32S2 || IDF_TARGET_ESP32S3
        help
            每条I2C指令超时时间.
endmenu
```
